## boards/shields/nice_view_custom/Kconfig.shield
```kconfig
# SPDX-License-Identifier: MIT

config SHIELD_NICE_VIEW_CUSTOM
    def_bool $(shields_list_contains,nice_view_custom)
    select SHIELD_NICE_VIEW
```

## boards/shields/nice_view_toyoterm/Kconfig.shield
```kconfig
# SPDX-License-Identifier: MIT

config SHIELD_NICE_VIEW_TOYOTERM
    def_bool $(shields_list_contains,nice_view_toyoterm)
    select SHIELD_NICE_VIEW
```
